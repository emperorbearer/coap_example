## CMakeLists.txt
```
# SPDX-License-Identifier: Apache-2.0
cmake_minimum_required(VERSION 3.20.0)

find_package(Zephyr REQUIRED HINTS $ENV{ZEPHYR_BASE})
project(coap_switch)

target_include_directories(app PRIVATE ${CMAKE_CURRENT_SOURCE_DIR}/../common)

target_sources(app PRIVATE
  src/main.c
  ../common/binding.c
)
```

## Kconfig
```
source "Kconfig.zephyr"

config APP_SWITCH_MAINTAINED
	bool "Wall switch is maintained (rocker) type"
	default y
	help
	  When enabled, the switch reports the physical on/off position of a
	  maintained wall switch (PUT explicit state). When disabled, the input
	  is treated as a momentary push and each press toggles the light (POST).
```

## prj.conf
```kconfig
# --- Switch node (battery-powered Thread Sleepy End Device) ---

# Networking + IPv6 + sockets
CONFIG_NETWORKING=y
CONFIG_NET_IPV6=y
CONFIG_NET_UDP=y
CONFIG_NET_SOCKETS=y
CONFIG_NET_CONNECTION_MANAGER=y

# OpenThread as a Minimal Thread Device, Sleepy End Device for battery life.
CONFIG_NET_L2_OPENTHREAD=y
CONFIG_OPENTHREAD_MTD=y
CONFIG_OPENTHREAD_MTD_SED=y
CONFIG_OPENTHREAD_JOINER=y
# Low-power "sender-only" profile: this switch only transmits (button -> light)
# and needs no unsolicited downlink, so CSL receive is left DISABLED to avoid
# its periodic radio wake (~5-10 uA). CoAP ACKs still arrive right after our own
# TX (radio already on). A long data-poll keep-alive stays attached to the
# parent; keep the period below the parent's child timeout (default 240 s).
# CONFIG_OPENTHREAD_CSL_RECEIVER is not set
CONFIG_OPENTHREAD_POLL_PERIOD=120000
# See docs/hardware/power-budget.md for the battery-life analysis.

# CoAP client (request/response helper)
CONFIG_COAP=y
CONFIG_COAP_CLIENT=y
CONFIG_ZCBOR=y

# Persist binding records (which light(s) this switch controls)
CONFIG_SETTINGS=y
CONFIG_FLASH=y
CONFIG_FLASH_MAP=y
CONFIG_NVS=y
CONFIG_SETTINGS_NVS=y

# GPIO input (wall-switch dry contact) with interrupt/sense wake
CONFIG_GPIO=y

# Power management: deep sleep between events
CONFIG_PM=y
CONFIG_PM_DEVICE=y

# Logging (disable or lower in production for power)
CONFIG_LOG=y

CONFIG_MAIN_STACK_SIZE=4096
CONFIG_HEAP_MEM_POOL_SIZE=8192
```

## boards/nrf54l15dk_nrf54l15_cpuapp.overlay
```dts
/*
 * Switch node pin mapping for the nRF54L15 DK.
 *
 * "wall-switch" is the dry-contact input from the existing mechanical wall
 * switch. It uses an internal pull-up here for bring-up on the DK; on the real
 * battery board prefer a high-value external pull-up (>=1 MOhm) enabled only
 * around edges to minimize leakage. The chosen pin must support GPIO SENSE so
 * it can wake the SoC from deep sleep. See docs/hardware/switch-node.md.
 */
/ {
	aliases {
		wall-switch = &wall_switch_in;
	};

	wall_switch_inputs {
		compatible = "gpio-keys";
		wall_switch_in: wall_switch_in {
			/* Example input pin; adjust to the terminal wired to the
			 * wall-switch dry contact. Active low = contact closed. */
			gpios = <&gpio1 11 (GPIO_PULL_UP | GPIO_ACTIVE_LOW)>;
			label = "Wall switch contact";
		};
	};
};
```

## src/main.c
```c
#include <zephyr/kernel.h>
#include <zephyr/drivers/gpio.h>
#include <zephyr/logging/log.h>
#include <zephyr/net/openthread.h>

#include "binding.h"

LOG_MODULE_REGISTER(switch_main, LOG_LEVEL_INF);

/* Wall-switch dry contact input. Provided by the board overlay as the
 * "wall-switch" alias. Maintained (rocker) type by default: the pin level
 * reflects the physical on/off position.
 */
#define WALL_SWITCH_NODE DT_ALIAS(wall_switch)
#if !DT_NODE_EXISTS(WALL_SWITCH_NODE)
#error "Board overlay must define a 'wall-switch' GPIO alias"
#endif
static const struct gpio_dt_spec wall_switch =
	GPIO_DT_SPEC_GET(WALL_SWITCH_NODE, gpios);

/* Set at build time: true = maintained (send state), false = momentary (toggle). */
#define SWITCH_MAINTAINED IS_ENABLED(CONFIG_APP_SWITCH_MAINTAINED)

/* Optional commissioning button to (re)bind this switch to a light. */
#define BUTTON_NODE DT_ALIAS(sw0)
#if DT_NODE_EXISTS(BUTTON_NODE)
static const struct gpio_dt_spec button = GPIO_DT_SPEC_GET(BUTTON_NODE, gpios);
static struct gpio_callback button_cb;
#endif

static struct gpio_callback wall_cb;
static struct k_work_delayable debounce_work;
static int last_reported = -1;

#define DEBOUNCE_MS 30

static void debounce_handler(struct k_work *work)
{
	ARG_UNUSED(work);

	int level = gpio_pin_get_dt(&wall_switch); /* logical: 1 = "on" */

	if (level < 0) {
		return;
	}
	if (SWITCH_MAINTAINED) {
		if (level == last_reported) {
			return; /* no net change after bounce */
		}
		last_reported = level;
		LOG_INF("wall switch -> %s", level ? "ON" : "OFF");
		binding_dispatch(true, level != 0);
	} else {
		LOG_INF("wall switch pressed -> toggle");
		binding_dispatch(false, false);
	}
}

static void wall_switch_isr(const struct device *dev, struct gpio_callback *cb,
			    uint32_t pins)
{
	ARG_UNUSED(dev);
	ARG_UNUSED(cb);
	ARG_UNUSED(pins);

	/* Wake from sleep and debounce before acting. */
	k_work_reschedule(&debounce_work, K_MSEC(DEBOUNCE_MS));
}

#if DT_NODE_EXISTS(BUTTON_NODE)
static void commission_isr(const struct device *dev, struct gpio_callback *cb,
			   uint32_t pins)
{
	ARG_UNUSED(dev);
	ARG_UNUSED(cb);
	ARG_UNUSED(pins);
	/* TODO: trigger multicast discovery (GET /.well-known/core?rt=light.switch)
	 * and bind to the responding light. See docs/architecture.md section 5.
	 */
	LOG_INF("commissioning button: start discovery/binding");
}
#endif

static int setup_inputs(void)
{
	int err;

	if (!gpio_is_ready_dt(&wall_switch)) {
		return -ENODEV;
	}
	err = gpio_pin_configure_dt(&wall_switch, GPIO_INPUT);
	if (err) {
		return err;
	}
	/* Interrupt on both edges so we catch on->off and off->on, and it can
	 * wake the SoC from deep sleep via GPIO SENSE. */
	err = gpio_pin_interrupt_configure_dt(&wall_switch,
					      GPIO_INT_EDGE_BOTH);
	if (err) {
		return err;
	}
	gpio_init_callback(&wall_cb, wall_switch_isr, BIT(wall_switch.pin));
	gpio_add_callback(wall_switch.port, &wall_cb);

#if DT_NODE_EXISTS(BUTTON_NODE)
	if (gpio_is_ready_dt(&button)) {
		gpio_pin_configure_dt(&button, GPIO_INPUT);
		gpio_pin_interrupt_configure_dt(&button, GPIO_INT_EDGE_TO_ACTIVE);
		gpio_init_callback(&button_cb, commission_isr, BIT(button.pin));
		gpio_add_callback(button.port, &button_cb);
	}
#endif
	return 0;
}

int main(void)
{
	LOG_INF("CoAP-over-Thread switch node starting (SSED)");

	if (binding_init() != 0) {
		LOG_ERR("binding init failed");
		return -1;
	}

	k_work_init_delayable(&debounce_work, debounce_handler);

	if (setup_inputs() != 0) {
		LOG_ERR("input setup failed");
		return -1;
	}

	/* Report initial position so the light matches the wall switch at boot. */
	if (SWITCH_MAINTAINED) {
		k_work_reschedule(&debounce_work, K_MSEC(DEBOUNCE_MS));
	}

	LOG_INF("switch ready; sleeping between events");
	/* Everything else is interrupt-driven; the SSED sleeps otherwise. */
	return 0;
}
```

## src/binding.c
```c
#include <zephyr/kernel.h>
#include <zephyr/net/socket.h>
#include <zephyr/net/coap.h>
#include <zephyr/net/coap_client.h>
#include <zephyr/settings/settings.h>
#include <zephyr/logging/log.h>
#include <zcbor_encode.h>

#include "binding.h"

LOG_MODULE_REGISTER(binding, LOG_LEVEL_INF);

static struct binding_record bindings[SWITCH_MAX_BINDINGS];
static struct coap_client coap_client;

#define BINDING_SETTINGS_ROOT "sw"

/* --- persistence --- */

static int binding_settings_set(const char *name, size_t len,
				settings_read_cb read_cb, void *cb_arg)
{
	int idx;
	const char *next;

	if (settings_name_steq(name, "bind", &next) && next) {
		idx = atoi(next);
		if (idx < 0 || idx >= SWITCH_MAX_BINDINGS) {
			return -EINVAL;
		}
		if (read_cb(cb_arg, &bindings[idx], sizeof(bindings[idx])) > 0) {
			return 0;
		}
	}
	return -ENOENT;
}

SETTINGS_STATIC_HANDLER_DEFINE(binding, BINDING_SETTINGS_ROOT, NULL,
			      binding_settings_set, NULL, NULL);

static void binding_persist(int idx)
{
	char key[32];

	snprintk(key, sizeof(key), BINDING_SETTINGS_ROOT "/bind/%d", idx);
	settings_save_one(key, &bindings[idx], sizeof(bindings[idx]));
}

int binding_init(void)
{
	int err = coap_client_init(&coap_client, NULL);

	if (err) {
		LOG_ERR("coap_client_init: %d", err);
		return err;
	}
	settings_subsys_init();
	settings_load_subtree(BINDING_SETTINGS_ROOT);
	return 0;
}

int binding_add(const struct in6_addr *target, const char *uri,
		uint8_t mode, uint8_t flags)
{
	for (int i = 0; i < SWITCH_MAX_BINDINGS; i++) {
		if (!bindings[i].in_use) {
			bindings[i].in_use = true;
			bindings[i].target = *target;
			strncpy(bindings[i].uri, uri ? uri : COAP_URI_LIGHT,
				sizeof(bindings[i].uri) - 1);
			bindings[i].mode = mode;
			bindings[i].flags = flags;
			binding_persist(i);
			return i;
		}
	}
	return -ENOMEM;
}

void binding_clear(void)
{
	for (int i = 0; i < SWITCH_MAX_BINDINGS; i++) {
		memset(&bindings[i], 0, sizeof(bindings[i]));
		binding_persist(i);
	}
}

/* --- sending --- */

/* Encode {"on":bool,"src":"switch"} into buf; returns length or negative. */
static int encode_state(bool on, uint8_t *buf, size_t buf_len)
{
	ZCBOR_STATE_E(enc, 1, buf, buf_len, 1);
	bool ok = true;

	ok = ok && zcbor_map_start_encode(enc, 2);
	ok = ok && zcbor_tstr_put_lit(enc, LIGHT_KEY_ON);
	ok = ok && zcbor_bool_put(enc, on);
	ok = ok && zcbor_tstr_put_lit(enc, LIGHT_KEY_SRC);
	ok = ok && zcbor_tstr_put_lit(enc, LIGHT_SRC_SWITCH);
	ok = ok && zcbor_map_end_encode(enc, 2);

	return ok ? (int)(enc->payload - buf) : -ENOMEM;
}

static void coap_response_cb(int16_t code, size_t offset, const uint8_t *payload,
			     size_t len, bool last_block, void *user_data)
{
	ARG_UNUSED(offset);
	ARG_UNUSED(payload);
	ARG_UNUSED(len);
	ARG_UNUSED(last_block);
	ARG_UNUSED(user_data);

	if (code < 0) {
		LOG_WRN("CoAP request failed: %d", code);
	} else {
		LOG_INF("CoAP response: %d.%02d", code >> 5, code & 0x1f);
	}
}

static void send_to_binding(struct binding_record *b, bool maintained, bool on)
{
	int sock;
	struct sockaddr_in6 dst = {
		.sin6_family = AF_INET6,
		.sin6_port = htons(COAP_PORT),
		.sin6_addr = b->target,
	};
	uint8_t payload[24];
	int plen = 0;
	struct coap_client_request req = {
		.confirmable = (b->flags & BINDING_FLAG_CONFIRMABLE) != 0,
		.path = b->uri,
		.cb = coap_response_cb,
	};

	if (maintained && b->mode == BINDING_MODE_PUT_STATE) {
		plen = encode_state(on, payload, sizeof(payload));
		if (plen < 0) {
			return;
		}
		req.method = COAP_METHOD_PUT;
		req.fmt = COAP_CONTENT_FORMAT_APP_CBOR;
		req.payload = payload;
		req.len = plen;
	} else {
		/* Momentary switch or explicit toggle binding. */
		req.method = COAP_METHOD_POST;
	}

	sock = zsock_socket(AF_INET6, SOCK_DGRAM, IPPROTO_UDP);
	if (sock < 0) {
		LOG_ERR("socket: %d", errno);
		return;
	}
	if (zsock_connect(sock, (struct sockaddr *)&dst, sizeof(dst)) < 0) {
		LOG_ERR("connect: %d", errno);
		zsock_close(sock);
		return;
	}

	(void)coap_client_req(&coap_client, sock, (struct sockaddr *)&dst,
			      &req, NULL);

	zsock_close(sock);
}

void binding_dispatch(bool maintained, bool on)
{
	for (int i = 0; i < SWITCH_MAX_BINDINGS; i++) {
		if (bindings[i].in_use) {
			send_to_binding(&bindings[i], maintained, on);
		}
	}
}
```

## src/binding.h
```c
/*
 * Binding: which light(s) this switch controls, and how to reach them.
 * Records persist in NVS so bindings survive reboot / battery change.
 * See docs/coap-resource-model.md section 4.
 */
#ifndef BINDING_H_
#define BINDING_H_

#include <stdbool.h>
#include <stdint.h>
#include <zephyr/net/net_ip.h>
#include "coap_resources.h"

struct binding_record {
	bool in_use;
	struct in6_addr target;              /* light unicast or group address */
	char uri[SWITCH_BINDING_URI_MAX];    /* target resource, default "light" */
	uint8_t mode;                        /* enum binding_mode */
	uint8_t flags;                       /* BINDING_FLAG_* */
};

/* Load persisted bindings from NVS. */
int binding_init(void);

/* Add/replace a binding at the first free slot. Returns index or negative. */
int binding_add(const struct in6_addr *target, const char *uri,
		uint8_t mode, uint8_t flags);

/* Clear all bindings (e.g. factory reset). */
void binding_clear(void);

/* Deliver a switch event to all bindings.
 *   maintained==true : send the explicit on/off state (PUT).
 *   maintained==false: send a toggle (POST), 'on' ignored.
 */
void binding_dispatch(bool maintained, bool on);

#endif /* BINDING_H_ */
```
